# ATmega8 device description
Architecture: AVR8; Family: megaAVR
Programming and debug interfaces: ISP, HVPP
Registers are 8-bit, access not given, no defined reset value unless marked. A register's access mark holds for its fields unless they carry their own. Offsets are from the block's base; lines under a group give offsets from that group; [hi:lo] are bit positions; {n}, {i} and the like mark numbered series; 'fields as' and 'values as' point back to an identical list; <NAME> marks a mode.

## Ordering variants
ATmega8L-8AU: TQFP32, pinout TQFPQFN32, up to 8 MHz, -40 to 85 C, 2.7 to 5.5 V
ATmega8L-8PU: PDIP28, up to 8 MHz, -40 to 85 C, 2.7 to 5.5 V
ATmega8L-8MU: QFN32, pinout TQFPQFN32, up to 8 MHz, -40 to 85 C, 2.7 to 5.5 V
ATmega8-16AU: TQFP32, pinout TQFPQFN32, up to 16 MHz, -40 to 85 C, 4.5 to 5.5 V
ATmega8-16PU: PDIP28, up to 16 MHz, -40 to 85 C, 4.5 to 5.5 V
ATmega8-16MU: QFN32, pinout TQFPQFN32, up to 16 MHz, -40 to 85 C, 4.5 to 5.5 V
ATmega8L-8AN: TQFP32, pinout TQFPQFN32, up to 8 MHz, -40 to 105 C, 2.7 to 5.5 V
ATmega8L-8PN: PDIP28, up to 8 MHz, -40 to 105 C, 2.7 to 5.5 V
ATmega8L-8MN: QFN32, pinout TQFPQFN32, up to 8 MHz, -40 to 105 C, 2.7 to 5.5 V
ATmega8-16AN: TQFP32, pinout TQFPQFN32, up to 16 MHz, -40 to 105 C, 4.5 to 5.5 V
ATmega8-16PN: PDIP28, up to 16 MHz, -40 to 105 C, 4.5 to 5.5 V
ATmega8-16MN: QFN32, pinout TQFPQFN32, up to 16 MHz, -40 to 105 C, 4.5 to 5.5 V

## Memory
prog space: start 0x0000 size 0x2000, little endian
  0x0000 FLASH size 0x2000 flash, rw, executable, page 0x40
  0x1f00 BOOT_SECTION_1 size 0x0100 flash, rw, executable, page 0x40
  0x1e00 BOOT_SECTION_2 size 0x0200 flash, rw, executable, page 0x40
  0x1c00 BOOT_SECTION_3 size 0x0400 flash, rw, executable, page 0x40
  0x1800 BOOT_SECTION_4 size 0x0800 flash, rw, executable, page 0x40
signatures space: start 0 size 3, little endian
  0 SIGNATURES size 3 signatures, ro
fuses space: start 0 size 0x0002, little endian
  0 FUSES size 0x0002 fuses, rw
lockbits space: start 0 size 0x0001, little endian
  0 LOCKBITS size 0x0001 lockbits, rw
data space: start 0x0000 size 0x0460, little endian
  0x0000 REGISTERS size 0x0020 regs
  0x0020 MAPPED_IO size 0x0040 io
  0x0060 IRAM size 0x0400 ram
eeprom space: start 0x0000 size 0x0200, little endian
  0x0000 EEPROM size 0x0200 eeprom, rw, page 0x04
io space: start 0x00 size 0x40, little endian
osccal space: start 0 size 4, little endian
  0 OSCCAL size 4 osccal, ro

## Peripheral instances (address, pins/pin function, parameters)
AC at 0x00 — Analog Comparator
  pins: AIN1 PD7; AIN0 PD6
SPI at 0x00 — Serial Peripheral Interface
  pins: SCK PB5; MISO PB4; MOSI PB3; SS PB2
EXINT at 0x00 — External Interrupts
  pins: INT1 PD3; INT0 PD2
TC0 at 0x00 — Timer/Counter, 8-bit
  pins: T PD4
TC1 at 0x00 — Timer/Counter, 16-bit
  pins: OCB PB2; OCA PB1; ICP PB0; T PD5
TC2 at 0x00 — Timer/Counter, 8-bit Async
  pins: OC PB3
USART at 0x00
  pins: XCK PD4; TXD PD1; RXD PD0
TWI at 0x00 — Two Wire Serial Interface
  pins: SCL PC5; SDA PC4
WDT at 0x00 — Watchdog Timer
PORTB at 0x00 — I/O Port
  pins: P{n} PB{n} (n=0..7)
PORTC at 0x00 — I/O Port
  pins: P0 PC0; P1 PC1; P2 PC2; P3 PC3; P4 PC4; P5 PC5; P6 PC6
PORTD at 0x00 — I/O Port
  pins: P{n} PD{n} (n=0..7)
EEPROM at 0x00
CPU at 0x00 — CPU Registers
  parameters: CORE_VERSION=V2E
ADC at 0x00 — Analog-to-Digital Converter
  pins: ADC5 PC5; ADC4 PC4; ADC3 PC3; ADC2 PC2; ADC1 PC1; ADC0 PC0
FUSE at 0 in fuses — Fuses
LOCKBIT at 0 in lockbits — Lockbits

## Interrupts
0 RESET — External Pin, Power-on Reset, Brown-out Reset and Watchdog Reset
1 INT0 — External Interrupt Request 0
2 INT1 — External Interrupt Request 1
3 TIMER2_COMP — Timer/Counter2 Compare Match
4 TIMER2_OVF — Timer/Counter2 Overflow
5 TIMER1_CAPT — Timer/Counter1 Capture Event
6 TIMER1_COMPA — Timer/Counter1 Compare Match A
7 TIMER1_COMPB — Timer/Counter1 Compare Match B
8 TIMER1_OVF — Timer/Counter1 Overflow
9 TIMER0_OVF — Timer/Counter0 Overflow
10 SPI_STC — Serial Transfer Complete
11 USART_RXC — USART, Rx Complete
12 USART_UDRE — USART Data Register Empty
13 USART_TXC — USART, Tx Complete
14 ADC — ADC Conversion Complete
15 EE_RDY — EEPROM Ready
16 ANA_COMP — Analog Comparator
17 TWI — 2-wire Serial Interface
18 SPM_RDY — Store Program Memory Ready

## Properties
SIGNATURES: SIGNATURE0=0x1e, SIGNATURE1=0x93, SIGNATURE2=0x07

## Pinouts (pin number, pad)
PDIP28: 1 PC6, 2 PD0, 3 PD1, 4 PD2, 5 PD3, 6 PD4, 7 VCC, 8 GND, 9 PB6, 10 PB7, 11 PD5, 12 PD6, 13 PD7, 14 PB0, 15 PB1, 16 PB2, 17 PB3, 18 PB4, 19 PB5, 20 AVCC, 21 AREF, 22 GND, 23 PC0, 24 PC1, 25 PC2, 26 PC3, 27 PC4, 28 PC5
TQFPQFN32: 1 PD3, 2 PD4, 3 GND, 4 VCC, 5 GND, 6 VCC, 7 PB6, 8 PB7, 9 PD5, 10 PD6, 11 PD7, 12 PB0, 13 PB1, 14 PB2, 15 PB3, 16 PB4, 17 PB5, 18 AVCC, 19 ADC6, 20 AREF, 21 GND, 22 ADC7, 23 PC0, 24 PC1, 25 PC2, 26 PC3, 27 PC4, 28 PC5, 29 PC6, 30 PD0, 31 PD1, 32 PD2
