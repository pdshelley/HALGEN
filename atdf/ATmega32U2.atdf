# ATmega32U2 device description
Architecture: AVR8; Family: megaAVR
Programming and debug interfaces: ISP, HVPP, debugWIRE
Registers are 8-bit, access not given, no defined reset value unless marked. A register's access mark holds for its fields unless they carry their own. Offsets are from the block's base; lines under a group give offsets from that group; [hi:lo] are bit positions; {n}, {i} and the like mark numbered series; 'fields as' and 'values as' point back to an identical list; <NAME> marks a mode.

## Ordering variants
ATmega32U2-AU: TQFP32, pinout QUAD, up to 16 MHz, -40 to 85 C, 2.7 to 5.5 V
ATmega32U2-MU: QFN32, pinout QUAD, up to 16 MHz, -40 to 85 C, 2.7 to 5.5 V

## Memory
prog space: start 0x0000 size 0x8000, little endian
  0x0000 FLASH size 0x8000 flash, rw, executable, page 0x80
  0x7e00 BOOT_SECTION_1 size 0x0200 flash, rw, executable, page 0x80
  0x7c00 BOOT_SECTION_2 size 0x0400 flash, rw, executable, page 0x80
  0x7800 BOOT_SECTION_3 size 0x0800 flash, rw, executable, page 0x80
  0x7000 BOOT_SECTION_4 size 0x1000 flash, rw, executable, page 0x80
signatures space: start 0 size 3, little endian
  0 SIGNATURES size 3 signatures, ro
fuses space: start 0 size 0x0003, little endian
  0 FUSES size 0x0003 fuses, rw
lockbits space: start 0 size 0x0001, little endian
  0 LOCKBITS size 0x0001 lockbits, rw
data space: start 0x0000 size 0x0500, little endian
  0x0000 REGISTERS size 0x0020 regs
  0x0020 MAPPED_IO size 0x00e0 io
  0x0100 IRAM size 0x0400 ram
eeprom space: start 0x0000 size 0x0400, little endian
  0x0000 EEPROM size 0x0400 eeprom, rw, page 0x04
io space: start 0x00 size 0x40, little endian
osccal space: start 0 size 1, little endian
  0 OSCCAL size 1 osccal, ro

## Peripheral instances (address, pins/pin function, parameters)
PORTB at 0x00 — I/O Port
  pins: P{n} PB{n} (n=0..7)
PORTD at 0x00 — I/O Port
  pins: P{n} PD{n} (n=0..7)
PORTC at 0x00 — I/O Port
  pins: P0 PC0; P1 PC1; P2 PC2; P4 PC4; P5 PC5; P6 PC6; P7 PC7
SPI at 0x00 — Serial Peripheral Interface
  pins: MISO PB3; MOSI PB2; SCLK PB1; SS PB0
BOOT_LOAD at 0x00 — Bootloader
EEPROM at 0x00
TC0 at 0x00 — Timer/Counter, 8-bit
  pins: OCA PB7; OCB PD0; T PD7
TC1 at 0x00 — Timer/Counter, 16-bit
  pins: ICP PC7; OCA PC6; OCB PC5; OCC PB7; T PB4
PLL at 0x00 — Phase Locked Loop
USB_DEVICE at 0x00 — USB Device Registers
CPU at 0x00 — CPU Registers
  parameters: CORE_VERSION=V3
EXINT at 0x00 — External Interrupts
  pins: INT0 PD0; INT1 PD1; INT2 PD2; INT3 PD3; INT4 PC7; INT5 PD4; INT6 PD6; INT7 PD7; PCINT{n} PB{n} (n=0..7); PCINT8 PC6; PCINT9 PC5; PCINT10 PC4; PCINT11 PC2; PCINT12 PD5
USART1 at 0x00 — USART
  pins: RXD PD2; TXD PD3; XCK PD5; RTS PD6; CTS PD7
WDT at 0x00 — Watchdog Timer
AC at 0x00 — Analog Comparator
  pins: AIN0 PD1; AIN1 PD2; AIN2 PC2; AIN3 PD4; AIN4 PD5; AIN5 PD6; AIN6 PD7
FUSE at 0 in fuses — Fuses
LOCKBIT at 0 in lockbits — Lockbits

## Interrupts
0 RESET — External Pin,Power-on Reset,Brown-out Reset,Watchdog Reset,and JTAG AVR Reset. See Datasheet.
{n+1} INT{n} (n=0..7) — External Interrupt Request {n}
9 PCINT0 — Pin Change Interrupt Request 0
10 PCINT1 — Pin Change Interrupt Request 1
11 USB_GEN — USB General Interrupt Request
12 USB_COM — USB Endpoint/Pipe Interrupt Communication Request
13 WDT — Watchdog Time-out Interrupt
14 TIMER1_CAPT — Timer/Counter2 Capture Event
15 TIMER1_COMPA — Timer/Counter2 Compare Match B
16 TIMER1_COMPB — Timer/Counter2 Compare Match B
17 TIMER1_COMPC — Timer/Counter2 Compare Match C
18 TIMER1_OVF — Timer/Counter1 Overflow
19 TIMER0_COMPA — Timer/Counter0 Compare Match A
20 TIMER0_COMPB — Timer/Counter0 Compare Match B
21 TIMER0_OVF — Timer/Counter0 Overflow
22 SPI_STC — SPI Serial Transfer Complete
23 USART1_RX — USART1, Rx Complete
24 USART1_UDRE — USART1 Data register Empty
25 USART1_TX — USART1, Tx Complete
26 ANALOG_COMP — Analog Comparator
27 EE_READY — EEPROM Ready
28 SPM_READY — Store Program Memory Read

## Properties
SIGNATURES: JTAGID=0x958A, SIGNATURE0=0x1e, SIGNATURE1=0x95, SIGNATURE2=0x8a
OCD: OCD_REVISION=1, OCD_DATAREG=0x31, PROGBASE=0x0000

## Pinouts (pin number, pad)
QUAD: 1 XTAL1, 2 PC0, 3 GND, 4 VCC, 5 PC2, 6 PD0, 7 PD1, 8 PD2, 9 PD3, 10 PD4, 11 PD5, 12 PD6, 13 PD7, 14 PB0, 15 PB1, 16 PB2, 17 PB3, 18 PB4, 19 PB5, 20 PB6, 21 PB7, 22 PC7, 23 PC6, 24 PC1, 25 PC5, 26 PC4, 27 UCAP, 28 UGND, 29 D+, 30 D-, 31 UVCC, 32 AVCC
